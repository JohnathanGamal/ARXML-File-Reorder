AUTOSAR XML
6 x :
  ContainerA  # BB
  ContainerB  # AA
  ContainerC  # CC
  ContainerD  # EE
  ContainerE  # KK
  ContainerF  # OO
